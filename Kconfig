## Kconfig
```kconfig
config BT_REMOTE_PAIRING_WINDOW
    bool "Kopplungsmodus nur per Tastenkombi, Abbruch mit Play/Pause"
    depends on ZMK_BLE
    help
      Die Remote ist ohne gekoppelten PC unsichtbar. Sichtbar wird sie nur nach
      der Kopplungs-Kombi; Play/Pause, Ausschalten oder erfolgreiches Koppeln
      beenden den Kopplungsmodus. Benoetigt den ZMK-Patch aus patches/.

config BT_REMOTE_STATUS_LED
    bool "RGB-Status-LED: blau Kopplungsmodus, gruen verbunden, rot Akku schwach"
    depends on ZMK_BATTERY_REPORTING

if BT_REMOTE_STATUS_LED

config BT_REMOTE_STATUS_LED_CONNECT_MS
    int "Dauer des gruenen Aufleuchtens nach dem Verbinden (ms)"
    default 300

config BT_REMOTE_STATUS_LED_PAIRING_MS
    int "Halbe Periode des blauen Blinkens im Kopplungsmodus (ms)"
    default 100

config BT_REMOTE_STATUS_LED_LOWBAT_PERCENT
    int "Akku-Warnung ab diesem Ladestand (%)"
    default 15

config BT_REMOTE_STATUS_LED_LOWBAT_FLASH_MS
    int "Dauer des roten Blitzes bei schwachem Akku (ms)"
    default 100

config BT_REMOTE_STATUS_LED_LOWBAT_INTERVAL_S
    int "Abstand der roten Blitze bei schwachem Akku (s)"
    default 10

endif

config BT_REMOTE_DIAG
    bool "Diagnose: Bluetooth-Ereignisse per USB-Log mitschreiben"
    depends on BT
```

## boards/shields/bluetooth_remote/Kconfig.defconfig
```kconfig
if SHIELD_BLUETOOTH_REMOTE

config ZMK_KEYBOARD_NAME
    default "FRET Remote V1"

endif # SHIELD_BLUETOOTH_REMOTE
```

## boards/shields/bluetooth_remote/Kconfig.shield
```kconfig
config SHIELD_BLUETOOTH_REMOTE
    def_bool $(shields_list_contains,bluetooth_remote)
```

## boards/shields/fret_remote_xiao/Kconfig.defconfig
```kconfig
if SHIELD_FRET_REMOTE_XIAO

config ZMK_KEYBOARD_NAME
    default "FRET Remote V1"

endif # SHIELD_FRET_REMOTE_XIAO
```

## boards/shields/fret_remote_xiao/Kconfig.shield
```kconfig
config SHIELD_FRET_REMOTE_XIAO
    def_bool $(shields_list_contains,fret_remote_xiao)
```

## dts/bindings/behaviors/zmk,behavior-bt-remote-pairing.yaml
```yaml
description: BT Remote - Kopplungsmodus starten (alter PC wird geloescht)

compatible: "zmk,behavior-bt-remote-pairing"

include: zero_param.yaml
```

## dts/bindings/behaviors/zmk,behavior-bt-remote-power-off.yaml
```yaml
description: BT Remote - ausschalten (Animation, dann Soft Off)

compatible: "zmk,behavior-bt-remote-power-off"

include: zero_param.yaml
```
